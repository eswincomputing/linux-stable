/* SPDX-License-Identifier: GPL-2.0 */
/*
 * Copyright 2026, Beijing ESWIN Computing Technology Co., Ltd.. All rights reserved.
 *
 */

/dts-v1/;
/plugin/;

/ {
	fragment@0 {
		target =  <&es_ircut>;
		__overlay__ {
			ircut-gpio = <&porta 6 0>;
			eswin,pulse-width = <200>;
			eswin,camera-module-index = <0>;
			status = "okay";
		};
	};
};