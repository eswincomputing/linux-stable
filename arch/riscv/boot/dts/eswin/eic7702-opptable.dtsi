// SPDX-License-Identifier: GPL-2.0
/*
 * Device Tree Include file for pin control of Eswin EIC770x family SoC.
 *
 * Copyright 2024, Beijing ESWIN Computing Technology Co., Ltd.. All rights reserved.
 * SPDX-License-Identifier: GPL-2.0
 *
 * This program is free software: you can redistribute it and/or modify
 * it under the terms of the GNU General Public License as published by
 * the Free Software Foundation, version 2.
 *
 * This program is distributed in the hope that it will be useful,
 * but WITHOUT ANY WARRANTY; without even the implied warranty of
 * MERCHANTABILITY or FITNESS FOR A PARTICULAR PURPOSE.  See the
 * GNU General Public License for more details.
 *
 * You should have received a copy of the GNU General Public License
 * along with this program.  If not, see <https://www.gnu.org/licenses/>.
 */

#include <dt-bindings/clock/eswin,eic7700-clock.h>
#include "eic7700-opptable.dtsi"

&cpu_opp_table {
	/delete-node/ opp-400000000;
	/delete-node/ opp-500000000;
	/delete-node/ opp-600000000;
	/delete-node/ opp-700000000;
	/delete-node/ opp-800000000;
	/delete-node/ opp-1000000000;
	/delete-node/ opp-1100000000;
	/delete-node/ opp-1200000000;
	/delete-node/ opp-1300000000;
};