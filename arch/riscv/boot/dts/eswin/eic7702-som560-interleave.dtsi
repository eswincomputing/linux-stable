// SPDX-License-Identifier: GPL-2.0
/*
 * Device Tree file for Eswin EIC7702 SoC.
 *
 * Copyright 2024, Beijing ESWIN Computing Technology Co., Ltd.. All rights reserved.
 * SPDX-License-Identifier: GPL-2.0
 *
 * This program is free software: you can redistribute it and/or modify
 * it under the terms of the GNU General Public License as published by
 * the Free Software Foundation, version 2.
 *
 * This program is distributed in the hope that it will be useful,
 * but WITHOUT ANY WARRANTY; without even the implied warranty of
 * MERCHANTABILITY or FITNESS FOR A PARTICULAR PURPOSE.  See the
 * GNU General Public License for more details.
 *
 * You should have received a copy of the GNU General Public License
 * along with this program.  If not, see <https://www.gnu.org/licenses/>.
 */

/dts-v1/;

#define RTCCLK_FREQ		1000000
#define LSPCLK_FREQ		200000000

/* If wanna enable ECC capability of DDR, should reserve highest zone of 1/8 all space for it */
#define MEMORY_SIZE_H		0x4
#define MEMORY_SIZE_L		0x0
#define CMA_SIZE		0x20000000

#include "eswin-win2030-die0-soc.dtsi"
#include "eswin-win2030-die1-soc.dtsi"

#include "eic7x-die0-pinctrl.dtsi"
#include "eic7x-die1-pinctrl.dtsi"
#include <dt-bindings/interrupt-controller/irq.h>
#include <dt-bindings/gpio/gpio.h>
#include <dt-bindings/input/input.h>

/* Clock frequency (in Hz) of the PCB crystal for rtcclk */

/ {
	#address-cells = <2>;
	#size-cells = <2>;
	model = "ESWIN EIC7702 SOM560";

	aliases {
		serial0 = &d0_uart0;
		ethernet0 = &d0_gmac0;
		ethernet1 = &d0_gmac1;
		ethernet2 = &d1_gmac0;
		ethernet3 = &d1_gmac1;
		rtc0 = &die0_rtc;
	};

	chosen {
		stdout-path = "serial0:115200n8";
	};

	cpus {
		timebase-frequency = <RTCCLK_FREQ>;
	};

	memory@59000000 {
		device_type = "memory";
		reg = <0x0 0x59000000 0x0 0x400000>;
		numa-node-id = <0>;
	};

	memory@79000000 {
		device_type = "memory";
		reg = <0x0 0x79000000 0x0 0x400000>;
		numa-node-id = <1>;
	};

	memory@4000000000 {
		device_type = "memory";
		reg = <0x40 0x00000000 0x0 0x80000000>;
		numa-node-id = <0>;
	};
	memory@4100000000 {
		device_type = "memory";
		reg = <0x41 0x00000000 0x1 0xe0000000>;
		numa-node-id = <0>;
	};
	memory@42e0000000 {
		device_type = "memory";
		reg = <0x42 0xe0000000 0x1 0xe0000000>;
		numa-node-id = <1>;
	};
	memory@c0000000 {
		device_type = "memory";
		reg = <0x00 0xc0000000 0x0 0x40000000>;
		numa-node-id = <0>;
	};
	memory@2040000000 {
		device_type = "memory";
		reg = <0x20 0x40000000 0x0 0x400000>;
		numa-node-id = <1>;
	};
	memory@300000000 {
		device_type = "memory";
		reg = <0x3 0x0 0x1 0x80000000>;
		numa-node-id = <0>;
	};
	memory@2280000000 {
		device_type = "memory";
		reg = <0x22 0x80000000 0x1 0x80000000>;
		numa-node-id = <1>;
	};
	memory@2e00000000 {
		device_type = "memory";
		reg = <0x2 0xe0000000 0x0 0x20000000>;
		numa-node-id = <0>;
	};
	memory@2260000000 {
		device_type = "memory";
		reg = <0x22 0x60000000 0x0 0x20000000>;
		numa-node-id = <1>;
	};
	reserved-memory {
		#address-cells = <2>;
		#size-cells = <2>;
		ranges;
		linux,cma {
			compatible = "shared-dma-pool";
			reusable;
			size = <0x0 CMA_SIZE>;
			alignment = <0x0 0x1000>;
			alloc-ranges = <0x41 0x00000000 0x1 0x0>,<0x43 0x00000000 0x1 0x0>;
			linux,cma-default;
		};
		mmz_nid_0_part_0 {
			compatible = "eswin-reserve-memory";
			reg = <0x3 0x0 0x1 0x80000000>;
			no-map;
		};
		mmz_nid_1_part_0 {
			compatible = "eswin-reserve-memory";
			reg = <0x22 0x80000000 0x1 0x80000000>;
			no-map;
		};
		npu0_reserved: sprammemory@59000000 {
			no-map;
			reg = <0x0 0x59000000 0x0 0x400000>;
		};

		npu1_reserved: sprammemory@79000000 {
			no-map;
			reg = <0x0 0x79000000 0x0 0x400000>;
		};

		d0_dc_reserved: d0_dc_reserved@2e0000000 {
			compatible = "shared-dma-pool";
			reusable;
			reg = <0x2 0xe0000000 0x0 0x20000000>;
		};

		d1_dc_reserved: d1_dc_reserved@2260000000 {
			compatible = "shared-dma-pool";
			reusable;
			reg = <0x22 0x60000000 0x0 0x20000000>;
		};

		// g2d_4GB_boundary_reserved_4k {
		// 	no-map;
		// 	reg = <0x0 0xfffff000 0x0 0x1000>;
		// };

		lpcpu_reserved: g2d_8GB_boundary_reserved_4k { // 32M reserved for lpcpu
			no-map;
			reg = <0x1 0xfe000000 0x0 0x2000000>;
		};

		// g2d_12GB_boundary_reserved_4k {
		// 	no-map;
		// 	reg = <0x2 0xfffff000 0x0 0x1000>;
		// };

		nid_1_zero_device_simu: nid_1_zero_device_simu@2040000000 {
			no-map;
			reg = <0x20 0x40000000 0x0 0x400000>;
		};
		// d1_g2d_4GB_boundary_reserved_4k {
		// 	no-map;
		// 	reg = <0x20 0xfffff000 0x0 0x1000>;
		// };

		d1_lpcpu_reserved: d1_g2d_8GB_boundary_reserved_4k { // 32M reserved for lpcpu
			no-map;
			reg = <0x21 0xfe000000 0x0 0x2000000>;
		};
	};

	distance-map {
		compatible = "numa-distance-map-v1";
		distance-matrix = <0 0 10>,
				<0 1 100>,
				<1 0 100>,
				<1 1 10>;
	};

	reg_vdd_cpux: vdd-cpux-regulator {
		compatible = "regulator-gpio";
		regulator-name = "vdd-cpux";
		regulator-type = "voltage";
		regulator-boot-on;
		regulator-always-on;
		regulator-min-microvolt = <800000>;
		regulator-max-microvolt = <900000>;

		pinctrl-names = "default";
		pinctrl-0 = <&pinctrl_die0_gpio94_default>;
		gpios = <&portc 30 GPIO_ACTIVE_HIGH>;
		enable-active-high;
		gpios-states = <0>;
		states = <800000 0>, <900000 1>;
	};

	eswin_cpufreq {
		compatible = "eswin,eic772x-cpufreq";
		status = "okay";
	};
};

&cpu_0 {
	cpu-supply = <&reg_vdd_cpux>;
};

&cpu_4 {
	cpu-supply = <&reg_vdd_cpux>;
};

&d0_clock {
	status = "okay";
};

&d1_clock {
	status = "okay";
};

&D1CACHE {
	status = "okay";
	d1_zero_device: zero-device@3a000000 {
		compatible = "l3,zero-device";
		/*reg = <0x0 0x3a000000 0x0 0x400000>;*/
		memory-region = <&nid_1_zero_device_simu>;
	};
};

&d0_reset {
	status = "okay";
};
&d1_reset {
	status = "okay";
};

&d0_pmu {
	status = "okay";
	npu-supply = <&d0_npu_vcc>;
};
&d1_pmu {
	status = "okay";
	npu-supply = <&d1_npu_vcc>;
};

&ddr0 {
	status = "okay";
};

&ddr1 {
	status = "okay";
};

&d1_ddr0 {
	status = "okay";
};

&d1_ddr1 {
	status = "okay";
};

&smmu0 {
	status = "okay";
};
&smmu1 {
	status = "okay";
};

&smmu_pmu0 {
	status = "disabled";
};
&smmu_pmu1 {
	status = "disabled";
};


&dev_foo_a {
	status = "okay";
};

&d0_cfg_noc {
	status = "okay";
};

&d0_llc_noc {
	status = "okay";
	stat,0 = "TracePort:ddr0_p0_req";
	stat,1 = "TracePort:ddr1_p0_req";
	//latency,0 = "TracePort:llcnoc_trans_probe";
	//pending,0 = "TracePort:llcnoc_trans_probe";
};

&d0_sys_noc {
	status = "okay";

	//eswin,DSPT-qos-owner;
	//eswin,NPU-qos-owner;
	//eswin,SPISLV_TBU3-qos-owner;

	stat,0 = "TracePort:ddr0_p1_req",
		 "InitFlow:mcput_snoc_mp/I/0";

	stat,1 = "TracePort:ddr0_p2_req",
		 "InitFlow:dspt_snoc/I/0",
		 "AddrBase:0x81000000", "AddrSize:0x30",
		 "Opcode:RdWrLockUrg", "Status:ReqRsp", "Length:0x8000", "Urgency:0x0";

	stat,2 = "TracePort:ddr1_p1_req",
		 "Status:Req", "AddrSize:0x28";

	stat,3 = "TracePort:ddr1_p2_req";

	latency,0 = "TracePort:sysnoc_trans_probe_0", "AddrSize:0x0";
	latency,1 = "TracePort:sysnoc_trans_probe_1","Mode:latency","AddrBase:0x82000000","AddrSize:0x28","Opcode:RdWr";
	//latency,2 = "TracePort:sysnoc_trans_probe_2";

	//pending,0 = "TracePort:sysnoc_trans_probe_0";
	//pending,1 = "TracePort:sysnoc_trans_probe_1","Mode:latency","AddrBase:0x82000000","AddrSize:0x0","Opcode:RdWr";
	pending,0 = "TracePort:sysnoc_trans_probe_2", "AddrSize:0x3";
};

&d0_media_noc {
	status = "okay";

	//eswin,GPU-qos-owner;
	//eswin,TBU2-qos-owner;
	//eswin,VC-qos-owner;

	stat,0 = "TracePort:ddr0_p3_req";
	stat,1 = "TracePort:ddr1_p3_req";
	//latency,0 = "TracePort:mnoc_trans_probe";
	//pending,0 = "TracePort:mnoc_trans_probe";
};

&d0_realtime_noc {
	status = "okay";

	//eswin,TBU0-qos-owner;
	//eswin,VO-qos-owner;

	stat,0 = "TracePort:ddr0_p4_req";
	stat,1 = "TracePort:ddr1_p4_req";
	//latency,0 = "TracePort:rnoc_trans_probe";
	//pending,0 = "TracePort:rnoc_trans_probe";
};

&d0_noc_wdt {
	status = "okay";
};

&d1_cfg_noc {
	status = "okay";
};

&d1_llc_noc {
	status = "okay";
	stat,0 = "TracePort:ddr0_p0_req";
	stat,1 = "TracePort:ddr1_p0_req";
	//latency,0 = "TracePort:llcnoc_trans_probe";
	//pending,0 = "TracePort:llcnoc_trans_probe";
};

&d1_sys_noc {
	status = "okay";

	//eswin,DSPT-qos-owner;
	//eswin,NPU-qos-owner;
	//eswin,SPISLV_TBU3-qos-owner;

	stat,0 = "TracePort:ddr0_p1_req",
		 "InitFlow:mcput_snoc_mp/I/0";

	stat,1 = "TracePort:ddr0_p2_req",
		 "InitFlow:dspt_snoc/I/0",
		 "AddrBase:0x81000000", "AddrSize:0x30",
		 "Opcode:RdWrLockUrg", "Status:ReqRsp", "Length:0x8000", "Urgency:0x0";

	stat,2 = "TracePort:ddr1_p1_req",
		 "Status:Req", "AddrSize:0x28";

	stat,3 = "TracePort:ddr1_p2_req";

	latency,0 = "TracePort:sysnoc_trans_probe_0", "AddrSize:0x0";
	latency,1 = "TracePort:sysnoc_trans_probe_1","Mode:latency","AddrBase:0x82000000","AddrSize:0x28","Opcode:RdWr";
	//latency,2 = "TracePort:sysnoc_trans_probe_2";

	//pending,0 = "TracePort:sysnoc_trans_probe_0";
	//pending,1 = "TracePort:sysnoc_trans_probe_1","Mode:latency","AddrBase:0x82000000","AddrSize:0x0","Opcode:RdWr";
	pending,0 = "TracePort:sysnoc_trans_probe_2", "AddrSize:0x3";
};

&d1_media_noc {
	status = "okay";

	//eswin,GPU-qos-owner;
	//eswin,TBU2-qos-owner;
	//eswin,VC-qos-owner;

	stat,0 = "TracePort:ddr0_p3_req";
	stat,1 = "TracePort:ddr1_p3_req";
	//latency,0 = "TracePort:mnoc_trans_probe";
	//pending,0 = "TracePort:mnoc_trans_probe";
};

&d1_realtime_noc {
	status = "okay";

	//eswin,TBU0-qos-owner;
	//eswin,VO-qos-owner;

	stat,0 = "TracePort:ddr0_p4_req";
	stat,1 = "TracePort:ddr1_p4_req";
	//latency,0 = "TracePort:rnoc_trans_probe";
	//pending,0 = "TracePort:rnoc_trans_probe";
};

&d1_noc_wdt {
	status = "okay";
};

&d0_ipc_scpu {
	status = "okay";
};
&d1_ipc_scpu {
	status = "okay";
};

&d0_lpcpu {
	status = "okay";
	memory-region = <&lpcpu_reserved>;
	pinctrl-names = "default";
	pinctrl-0 = <&pinctrl_die0_gpio0_default>;
	irq-gpios = <&porta 0 GPIO_ACTIVE_HIGH>;
	control-gpio-names = "socvdd";
	control-gpio-ports = <21 GPIO_ACTIVE_HIGH>;
	wakeup-gpio-port = <0>;
};

&d1_lpcpu {
	status = "okay";
	memory-region = <&d1_lpcpu_reserved>;
	pinctrl-names = "default";
	pinctrl-0 = <&pinctrl_die1_gpio7_on_default>;
	irq-gpios = <&d1_porta 7 IRQ_TYPE_EDGE_BOTH>;
};
&d0_dmc {
        status = "okay";
};
&d1_dmc {
        status = "okay";
};
&pcie {
	status = "okay";
};
&d1_pcie {
	status = "okay";
};

&d0_npu {
	status = "okay";
	npu-supply = <&d0_npu_vcc>;
};
&d1_npu {
	status = "okay";
	npu-supply = <&d1_npu_vcc>;
};

&d0_dsp_subsys {
	status = "okay";
};
&d1_dsp_subsys {
	status = "okay";
};

&d0_dsp0 {
	status = "okay";
};
&d1_dsp0 {
	status = "okay";
};

&d0_dsp1 {
	status = "okay";
};
&d1_dsp1 {
	status = "okay";
};

&d0_dsp2 {
	status = "okay";
};
&d1_dsp2 {
	status = "okay";
};

&d0_dsp3 {
	status = "okay";
};
&d1_dsp3 {
	status = "okay";
};

&gpu0 {
	status = "okay";
};
&d1_gpu {
	status = "disabled";
};

&gc820 {
	status = "okay";
};
&d1_gc820 {
	status = "okay";
};

&vdec0 {
	status = "okay";
};
&vdec1 {
	status = "okay";
};

&venc0 {
	status = "okay";
};
&venc1 {
	status = "okay";
};

&video_output {
	status = "okay";
	memory-region = <&d0_dc_reserved>;
};

&d1_video_output {
	status = "okay";
	memory-region = <&d1_dc_reserved>;
};

&dc {
	status = "okay";
	dc_out: port {
		#address-cells = <1>;
		#size-cells = <0>;
		dc_out_dpi1: endpoint@1 {
			reg = <1>;
			remote-endpoint = <&vd_input>;
		};
		dc_out_hdmi: endpoint@2 {
			reg = <2>;
			remote-endpoint = <&hdmi_in_dc>;
		};
	};
};

&d1_dc {
	status = "okay";
	d1_dc_out: port {
		#address-cells = <1>;
		#size-cells = <0>;
		d1_dc_out_dpi1: endpoint@1 {
			reg = <1>;
			remote-endpoint = <&d1_vd_input>;
		};
		d1_dc_out_hdmi: endpoint@2 {
			reg = <2>;
			remote-endpoint = <&d1_hdmi_in_dc>;
		};
	};
};

&dc_test {
	status = "disabled";
};
&d1_dc_test {
	status = "disabled";
};

&virtual_display {
	status = "okay";
	port {
		vd_input: endpoint {
			remote-endpoint = <&dc_out_dpi1>;
		};
	};
};

&d1_virtual_display {
	status = "okay";
	port {
		d1_vd_input: endpoint {
			remote-endpoint = <&d1_dc_out_dpi1>;
		};
	};
};

&dw_hdmi {
	status = "okay";
	ports {
		#address-cells = <1>;
		#size-cells = <0>;
		port@0 {
			reg = <0>;
			hdmi_in_dc: endpoint@0 {
				remote-endpoint = <&dc_out_hdmi>;
			};
		};
		port@2 {
			reg = <2>;
			hdmi_in_i2s: endpoint@1 {
				system-clock-frequency = <12288000>;
				remote-endpoint = <&d0_i2s0_endpoint>;
			};
		};
	};
};
&d1_dw_hdmi {
	status = "okay";
	ports {
		#address-cells = <1>;
		#size-cells = <0>;
		port@0 {
			reg = <0>;
			d1_hdmi_in_dc: endpoint@0 {
				remote-endpoint = <&d1_dc_out_hdmi>;
			};
		};
		port@2 {
			reg = <2>;
			d1_hdmi_in_i2s: endpoint@1 {
				system-clock-frequency = <12288000>;
				remote-endpoint = <&d1_i2s0_endpoint>;
			};
		};
	};
};

&dw_hdmi_hdcp2 {
	status = "okay";
};
&d1_dw_hdmi_hdcp2 {
	status = "disabled";
};


&d0_i2s0 {
	status = "okay";
	numa-node-id = <0>;
	d0_i2s0_port: port {
		d0_i2s0_endpoint: endpoint {
			remote-endpoint = <&hdmi_in_i2s>;
			dai-format = "i2s";
		};
	};
};

&d1_i2s0 {
	status = "okay";
	numa-node-id = <1>;
	d1_i2s0_port: port {
		d1_i2s0_endpoint: endpoint {
			remote-endpoint = <&d1_hdmi_in_i2s>;
			dai-format = "i2s";
		};
	};
};

&d0_i2s1 {
	status = "okay";
};

&d1_i2s1 {
	/* unused */
	status = "disabled";
};

&d0_i2s2 {
	/* unused */
	status = "disabled";
};

&d1_i2s2 {
	/* unused */
	status = "disabled";
};

&d0_graphcard0 {
	status = "okay";
	label = "HDMI Audio-0";
	dais = <&d0_i2s0_port>;
};

&d0_graphcard1 {
	status = "okay";
};

&d0_graphcard2 {
	/* unused */
	status = "disabled";
};

&d1_graphcard0 {
	status = "okay";
	label = "HDMI Audio-1";
	dais = <&d1_i2s0_port>;
};

&d1_graphcard1 {
	/* unused */
	status = "disabled";
};

&d1_graphcard2 {
	/* unused */
	status = "disabled";
};

&vi_subsys {
	status = "okay";
};

&d1_vi_subsys {
	status = "okay";
};

&isp_0 {
	status = "okay";
};

&d1_isp_0 {
	status = "okay";
};

&isp_1 {
	status = "okay";
};

&d1_isp_1 {
	status = "okay";
};

&dewarp {
	status = "okay";
};

&d1_dewarp {
	status = "okay";
};

&sdhci_emmc {
	/* emmc */
	status = "okay";
	delay_code = <0x17>;
	drive-impedance-ohm = <50>;
	enable-cmd-pullup;
	enable-data-pullup;
	no-sdio;
	no-sd;
};

&d1_sdhci_emmc {
	/* unused */
	status = "disabled";
};

&sdio0 {
	status = "okay";
};

&d1_sdio0 {
	status = "okay";
};

&sdio1 {
	/* unused */
	status = "disabled";
};

&d1_sdio1 {
	/* unused */
	status = "disabled";
};

&d0_gmac0 {
	pinctrl-names = "default";
	pinctrl-0 = <&pinctrl_die0_gpio29_default>;
	rst-gpios = <&porta 29 GPIO_ACTIVE_LOW>;
	eswin,rgmiisel = <&pinctrl 0x290 0x3>;
	eswin,led-cfgs = <0x6100 0xa40 0x420>;
	phy-mode = "rgmii-txid";
	dly-param-1000m = <0x20202020 0x96206420 0x20202020>;
	dly-param-100m = <0x20202020 0x96205A20 0x20202020>;
	dly-param-10m = <0 0 0>;
	status = "okay";
};

&d1_gmac0 {
	pinctrl-names = "default";
	pinctrl-0 = <&pinctrl_die1_gpio29_default>;
	rst-gpios = <&d1_porta 29 GPIO_ACTIVE_LOW>;
	eswin,rgmiisel = <&d1_pinctrl 0x290 0x3>;
	eswin,led-cfgs = <0x6100 0xa40 0x420>;
	phy-mode = "rgmii-txid";
	dly-param-1000m = <0x20202020 0x8C205A20 0x20202020>;
	dly-param-100m = <0x20202020 0x96205A20 0x20202020>;
	dly-param-10m = <0 0 0>;
	status = "okay";
};

&d0_gmac1 {
	pinctrl-names = "default";
	pinctrl-0 = <&pinctrl_die0_gpio34_default>;
	rst-gpios = <&portb 2 GPIO_ACTIVE_LOW>;
	eswin,rgmiisel = <&pinctrl 0x294 0x3>;
	eswin,led-cfgs = <0x6100 0xa40 0x420>;
	phy-mode = "rgmii-txid";
	dly-param-1000m = <0x20202020 0x46205020 0x20202020>;
	dly-param-100m = <0x20202020 0x50205020 0x20202020>;
	dly-param-10m = <0 0 0>;
	status = "okay";
};

&d1_gmac1 {
	pinctrl-names = "default";
	pinctrl-0 = <&pinctrl_die1_gpio34_default>;
	rst-gpios = <&d1_portb 2 GPIO_ACTIVE_LOW>;
	eswin,rgmiisel = <&d1_pinctrl 0x294 0x3>;
	eswin,led-cfgs = <0x6100 0xa40 0x420>;
	dly-param-1000m = <0x20202020 0x46205A20 0x20202020>;
	dly-param-100m = <0x20202020 0x50205A20 0x20202020>;
	dly-param-10m = <0 0 0>;
	status = "okay";
};

&d0_sata {
	status = "okay";
};

&d0_sata_phy {
	status = "okay";
};

&d1_sata {
	status = "okay";
};

&d1_sata_phy {
	status = "okay";
};

&d0_usbdrd3_0 {
	status = "okay";
};

&d1_usbdrd3_0 {
	status = "okay";
};

&d0_usbdrd_dwc3_0 {
	status = "okay";
	dr_mode = "host";
	maximum-speed = "super-speed";
};

&d1_usbdrd_dwc3_0 {
	status = "okay";
	dr_mode = "host";
	maximum-speed = "super-speed";
};

&d0_usbdrd3_1 {
	status = "okay";
};

&d1_usbdrd3_1 {
	status = "okay";
};

&d0_usbdrd_dwc3_1 {
	status = "okay";
	dr_mode = "host";
	maximum-speed = "super-speed";
};

&d1_usbdrd_dwc3_1 {
	status = "okay";
	dr_mode = "host";
	maximum-speed = "super-speed";
};

&d0_dmac0 {
	status = "okay";
};

&d1_dmac0 {
	status = "okay";
};

&d0_aon_dmac {
	status = "okay";
};

&d1_aon_dmac {
	status = "okay";
};

&d0_uart0 {
	/* debug */
	status = "okay";
};

&d1_uart0 {
	status = "disabled";
};

&d0_uart1 {
	/* unused */
	status = "disabled";
};

&d1_uart1 {
	status = "okay";
};

&d0_uart2 {
	status = "okay";
};

&d1_uart2 {
	status = "okay";
};

&d0_uart3 {
	/* unused */
	status = "disabled";
};

&d1_uart3 {
	/* unused */
	status = "disabled";
};

&d0_uart4 {
	/* unused */
	status = "disabled";
};

&d1_uart4 {
	/* unused */
	status = "disabled";
};

&spi1 {
	status = "okay";
};
&d1_spi1 {
	status = "okay";
};

&spi2 {
	/* unused */
	status = "disabled";
};

&d1_spi2 {
	/* unused */
	status = "disabled";
};

&spi0 {
	/* spi flash */
	status = "okay";
	num-cs = <1>;
	spi-flash@0 {
		compatible = "winbond,w25q128jw",
					"jedec,spi-nor";
		reg = <0>;
		#address-cells = <1>;
		#size-cells = <1>;
		spi-max-frequency = <4800000>;
		rx-sample-delay-ns = <10>;
	};
};

&d1_spi0 {
	/* spi flash */
	status = "disabled";
	num-cs = <1>;
	spi-flash@0 {
		compatible = "winbond,w25q128jw",
					"jedec,spi-nor";
		reg = <0>;
		#address-cells = <1>;
		#size-cells = <1>;
		spi-max-frequency = <4800000>;
		rx-sample-delay-ns = <10>;
	};
};

&d0_mbox0 {
	status = "okay";
};
&d1_mbox0 {
	status = "okay";
};

&d0_mbox1 {
	status = "okay";
};
&d1_mbox1 {
	status = "okay";
};

&d0_mbox2 {
	status = "okay";
};
&d1_mbox2 {
	status = "okay";
};

&d0_mbox3 {
	status = "okay";
};
&d1_mbox3 {
	status = "okay";
};

&d0_mbox4 {
	status = "okay";
};
&d1_mbox4 {
	status = "okay";
};

&d0_mbox5 {
	status = "okay";
};
&d1_mbox5 {
	status = "okay";
};

&d0_mbox6 {
	status = "okay";
};
&d1_mbox6 {
	status = "okay";
};

&d0_mbox7 {
	status = "okay";
};
&d1_mbox7 {
	status = "okay";
};

&fan_control {
	status = "okay";
};
&d1_fan_control {
	status = "disabled";
};

&d0_i2c0 {
	status = "okay";
};

&d1_i2c0 {
	status = "okay";
};

&d0_i2c1 {
	status = "okay";
};
&d1_i2c1 {
	status = "okay";
};

&d0_i2c2 {
	status = "okay";
};

&d1_i2c2 {
	status = "okay";
};

&d0_i2c3 {
	status = "okay";
};
&d1_i2c3 {
	status = "okay";
};

&d0_i2c4 {
	status = "okay";
};
&d1_i2c4 {
	status = "okay";
};

&d0_i2c5 {
	status = "okay";
};
&d1_i2c5 {
	status = "okay";
};

&d0_i2c6 {
	/* unused */
	status = "disabled";
};
&d1_i2c6 {
	/* unused */
	status = "disabled";
};

&d0_i2c7 {
	/* unused */
	status = "disabled";
};
&d1_i2c7 {
	/* unused */
	status = "disabled";
};

&d0_i2c8 {
	status = "okay";
};
&d1_i2c8 {
	status = "okay";
};

&d0_i2c9 {
	status = "okay";
};
&d1_i2c9 {
	status = "okay";
};

&d0_aon_i2c0 {
	/* unused */
	status = "disabled";
};

&d1_aon_i2c0 {
	/* unused */
	status = "disabled";
};

&d0_aon_i2c1 {
	/* d2d vp pmic(5p49v6965) & temp sensor(tmp102) & d0 npu pmic(tps549d22) */
	status = "okay";
	tmp102@48 {
		compatible = "ti,tmp102";
		reg = <0x48>;
		label = "d0_board_tmp";
		#thermal-sensor-cells = <1>;
	};

	tps549d22@10 {
		compatible = "ti,tps549d22";
		reg = <0x10>;
		eswin,regulator_default-microvolt=<1000000>;
		eswin,regulator_label = "Supply VDD", "D0 NPU Voltage";
		label = "npu_vdd";
		regulators{
			d0_npu_vcc:npu_svcc{
				regulator-name="D0_NPU_SVCC";
				regulator-min-microvolt=<700000>;
				regulator-max-microvolt=<1100000>;
				regulator-min-microamp=<20000000>;
				regulator-max-microamp=<40000000>;
				regulator-ov-protection-microvolt=<1100000>;
			};
		};
	};
};

&d1_aon_i2c1 {
	/* d1 npu pmic */
	status = "okay";
	tps549d22@10 {
		compatible = "ti,tps549d22";
		reg = <0x10>;
		eswin,regulator_default-microvolt=<1000000>;
		eswin,regulator_label = "Supply VDD1", "D1 NPU Voltage";
		label = "d1_npu_vdd";
		regulators{
			d1_npu_vcc:npu_svcc{
				regulator-name="D1_NPU_SVCC";
				regulator-min-microvolt=<700000>;
				regulator-max-microvolt=<1100000>;
				regulator-min-microamp=<20000000>;
				regulator-max-microamp=<40000000>;
				regulator-ov-protection-microvolt=<1100000>;
			};
		};
	};
};

&pwm0 {
	/* fan */
	status = "okay";
	pinctrl-names = "default", "sleep";
	pinctrl-0 = <&pinctrl_die0_pwm0_default>;
	pinctrl-1 = <&pinctrl_die0_gpio68_default>;
	pwm-gpios = <&portc 4 GPIO_ACTIVE_LOW>;
};
&d1_pwm0 {
	status = "okay";
	pinctrl-names = "default", "sleep";
	pinctrl-0 = <&pinctrl_die1_pwm0_default &pinctrl_die1_pwm1_default &pinctrl_die1_pwm2_default>;
	pinctrl-1 = <&pinctrl_die1_gpio68_default &pinctrl_die1_gpio40_default &pinctrl_die1_gpio41_default>;
	pwm-gpios = <&d1_portc 4 GPIO_ACTIVE_LOW
				&d1_portb 8 GPIO_ACTIVE_LOW
				&d1_portb 9 GPIO_ACTIVE_LOW>;
};

&pvt0 {
	status = "okay";
	compatible = "eswin,eswin-dummy-pvt-cpu";
	eswin,data-reg = <0x0 0x51810000 0x0668>;
};
&d1_pvt0 {
	status = "okay";
	compatible = "eswin,eswin-dummy-pvt-cpu";
	eswin,data-reg = <0x0 0x71810000 0x0668>;
};

&pvt1 {
	status = "okay";
};
&d1_pvt1 {
	status = "okay";
};

&wdt0 {
	status = "okay";
};
&d1_wdt0 {
	status = "okay";
};

&wdt1 {
	status = "okay";
};
&d1_wdt1 {
	status = "okay";
};

&wdt2 {
	status = "okay";
};
&d1_wdt2 {
	status = "okay";
};

&wdt3 {
	status = "okay";
};
&d1_wdt3 {
	status = "okay";
};

&die0_rtc {
	status = "okay";
};
&d1_rtc {
	status = "okay";
};

&pinctrl {
	status = "okay";
};
&d1_pinctrl {
	status = "okay";
};

&gpio0 {
	status = "okay";
};
&d1_gpio0 {
	status = "okay";
};

&d0_dev_llc {
	npu-supply = <&d0_npu_vcc>;
	status = "okay";
};
&d1_dev_llc {
	npu-supply = <&d1_npu_vcc>;
	status = "okay";
};


