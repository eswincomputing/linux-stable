## drivers/clk/eswin/Kconfig
```kconfig
# SPDX-License-Identifier: GPL-2.0

config COMMON_CLK_EIC7700
	bool "EIC7700 Clock Driver"
	help
	  Build the Eswin EIC7700 SOC clock driver based on the common clock framework.
	  This driver provides support for the clock control on the Eswin EIC7700 SoC,
	  which is essential for managing clock rates and power management.

if COMMON_CLK_EIC7700
	source "drivers/clk/eswin/test/Kconfig"
endif
```

## drivers/clk/eswin/test/Kconfig
```kconfig
# SPDX-License-Identifier: GPL-2.0-only

config COMMON_CLK_EIC7700_TEST
	bool "Eswin Clock Driver Test"
	default y
	help
	  Build the Eswin clock test driver
```

## drivers/crypto/eswin/Kconfig
```kconfig
# SPDX-License-Identifier: GPL-2.0

config CRYPTO_DEV_ESWIN_EIC770x
	tristate "Support for ESWIN EIC7X crypto block cipher accelerator"
	depends on ARCH_ESWIN_EIC770X_SOC_FAMILY
	help
	  Support for ESWIN SEC Engine in EIC770X SoC

	  To compile this as a module, choose M here: the module
	  will be called es_cipher.
```

## drivers/interconnect/eswin/Kconfig
```kconfig
# SPDX-License-Identifier: GPL-2.0

config INTERCONNECT_ESWIN
	tristate "Enable Eswin SoC NOC Management driver"
	default y
	help
	  Say yes to enable NOC management support for Eswin SoC.
	  say M to compile it as a module.
	  If in doubt, say N.

config INTERCONNECT_ESWIN_DEBUG
	bool "Debug Eswin NOC"
	depends on INTERCONNECT_ESWIN
	help
	  This enables verbose debug output of the eswin NOC driver.
	  If unsure, say N.

config INTERCONNECT_WIN2030_WDT
	bool "win2030 interconnect wdt driver"
	default y
	help
	  This driver will log the NOC wdt interrupt, usually indicate a timeout on NOC
	  system.
	depends on INTERCONNECT_ESWIN
```

## drivers/media/platform/eswin/dvp2axi/Kconfig
```kconfig
# SPDX-License-Identifier: GPL-2.0
config VIDEO_ESWIN_DVP2AXI_DEPENDENCES
	bool "Eswin Camera AXI2DVP dependences"
	default "y"
	select MEDIA_CAMERA_SUPPORT
	select VIDEO_V4L2
	select MEDIA_CONTROLLER
	select VIDEO_V4L2_SUBDEV_API
	select VIDEOBUF2_DMA_CONTIG
	select V4L2_FWNODE
	select VIDEOBUF2_CMA_SG
	select VIDEOBUF2_VMALLOC
	select V4L2_CCI_I2C
	help
	  Support for DVP2AXi dependences

config VIDEO_ESWIN_DVP2AXI
	tristate "Eswin Camera AXI2DVP driver"
	depends on VIDEO_ESWIN_DVP2AXI_DEPENDENCES
#	select MEDIA_CAMERA_SUPPORT
#	select VIDEO_V4L2
#	select MEDIA_CONTROLLER
#	select VIDEO_V4L2_SUBDEV_API
#	select VIDEOBUF2_DMA_CONTIG
#	select V4L2_FWNODE
#	select VIDEOBUF2_CMA_SG
#	select VIDEOBUF2_VMALLOC
	help
	  Support for DVP2AXi on the eswin eic770x

config ES_DVP2AXI_WORKMODE_ONEFRAME
	bool "Eswin Camera AXI2DVP Work Mode Test"
	default "y"
	help
	  Support for DVP2AXi ONEFRAME mode on the eswin eic770x
```

## drivers/media/platform/eswin/isp/Kconfig
```kconfig
# SPDX-License-Identifier: GPL-2.0-only
#
# Configuration for the eswin isp driver
#

config VIDEO_ESWIN_ISP
    tristate "ESWIN ISP driver support"
    default m
    depends on VIDEO_DEV
    select VIDEOBUF2_CORE
    help
      Enable support for the ESWIN ISP video interface driver.
      This driver is used for handling video input from ESWIN devices.
```

## drivers/media/platform/eswin/mipi-cdphy/Kconfig
```kconfig
config PHY_ESWIN_CSI2_DPHY
	tristate "Eswin CSI2 D-PHY Driver"
	select GENERIC_PHY
	select VIDEO_V4L2_SUBDEV_API
	select V4L2_FWNODE
	help
	  Enable this to support the Eswin CSI2 DPHY.
```

## drivers/memory/eswin/Kconfig
```kconfig
# SPDX-License-Identifier: GPL-2.0
config ESWIN_MC
	bool "ESWIN Memory Controller and reserved memory block support"
	default y
	depends on ARCH_ESWIN_EIC770X_SOC_FAMILY
	select SG_SPLIT
	help
	  This driver supports the Memory Controller (MC) hardware, especialy for 
	  LLC SPRAM controller, found on ESWIN SoCs. And the memblock of the reserved
	  memory declared with the compatible = "eswin-reserve-memory" property in dts
	  is also initialized.

if ESWIN_MC

config ESWIN_RSV_MEMBLOCK
	bool "ESWIN reserved memory block support"
	depends on MMU
	help
	  If reserved-memory has compatible = "eswin-reserve-memory" and
	  no-map properties, this memory block will be initialized and freed in
	  Eswin private buddy system. Using es_alloc_pages(memblock, order) to
	  alloc pages from this memory block and es_free_pages(memblock, page) to
	  free the pages to this memory block.

	  If unsure, say "n".

source "drivers/memory/eswin/codacache/Kconfig"
source "drivers/memory/eswin/es_buddy/Kconfig"
source "drivers/memory/eswin/es_proc/Kconfig"
source "drivers/memory/eswin/es_rsvmem_heap/Kconfig"
source "drivers/memory/eswin/es_mmz_vb/Kconfig"
source "drivers/memory/eswin/es_dev_buf/Kconfig"
source "drivers/memory/eswin/es_iommu_rsv/Kconfig"

endif
```

## drivers/memory/eswin/codacache/Kconfig
```kconfig
# SPDX-License-Identifier: GPL-2.0
config ESWIN_CODACACHE_CONTROLLER
	bool "ESWIN codacache controller support"
	help
	  The codacache, 4MB in total, could be entirely intialized as SPRAM, or partialy as
	  SPRAM and partilay as cache(i.e. Last Level Cache, LLC), or entirely as cache.
	  For example, if 2MB is initialized as SPRAM, then the reset of the codacache, 2MB
	  will be initialized as cache. The size of the SPRAM is determined by the reg size of
	  the spram node in dts. The below example shows that the codacache of 4MB is entirely
	  initialized as SPRAM.
	  npu0_reserved: sprammemory@59000000 {
		reg = <0x0 0x59000000 0x0 0x400000>;
	  };

	  If unsure, say "n".
```

## drivers/memory/eswin/es_buddy/Kconfig
```kconfig
# SPDX-License-Identifier: GPL-2.0

config ESWIN_BUDDY
	tristate "ESWIN buddy allocator for reserved memory"
	help
	  buddy allocator api.
```

## drivers/memory/eswin/es_dev_buf/Kconfig
```kconfig
# SPDX-License-Identifier: GPL-2.0

config ESWIN_DEV_DMA_BUF
	tristate "ESWIN dev dma buf interface"
	depends on ESWIN_RSVMEM_HEAP
	help
	  eswin device dma buf 
```

## drivers/memory/eswin/es_dma_memcp/Kconfig
```kconfig
# SPDX-License-Identifier: GPL-2.0

config ESWIN_DMA_MEMCP
	tristate "ESWIN DMA memory copy"
	help
	  ESWIN DMA memory copy device.
```

## drivers/memory/eswin/es_iommu_rsv/Kconfig
```kconfig
# SPDX-License-Identifier: GPL-2.0

config ESWIN_IOMMU_RSV
	tristate "ESWIN IOMMU reserved for device interface"
	help
	  eswin iommu rsv intf for device
```

## drivers/memory/eswin/es_malloc_dmabuf/Kconfig
```kconfig
# SPDX-License-Identifier: GPL-2.0

config ESWIN_MALLOC_DMABUF
	tristate "ESWIN Malloc to DMA-BUF"
	help
	  ESWIN Malloc to DMA-BUF.
```

## drivers/memory/eswin/es_mmz_vb/Kconfig
```kconfig
# SPDX-License-Identifier: GPL-2.0

config ESWIN_MMZ_VB
	tristate "ESWIN MMZ reserved memory VB"
	help
	  ESWIN MMZ reserved memory VB device.
```

## drivers/memory/eswin/es_proc/Kconfig
```kconfig
# SPDX-License-Identifier: GPL-2.0

config ESWIN_PROC
	tristate "ESWIN MMZ proc interface"
	help
	  MMZ proc interface for user space.
```

## drivers/memory/eswin/es_rsvmem_heap/Kconfig
```kconfig
# SPDX-License-Identifier: GPL-2.0

config ESWIN_RSVMEM_HEAP
	tristate "ESWIN reserved memory heap"
	help
	  ESWIN reserved memory heap device.
```

## drivers/reset-kdump/Kconfig
```kconfig
#
# Eswin reset to trigger kdump
#

menuconfig RSTKDUMP
	tristate "Eswin reset to trigger kdump"
	default n
	help
	  Eswin reset to trigger kdump.
```

## drivers/soc/eswin/Kconfig
```kconfig
source "drivers/soc/eswin/ai_driver/Kconfig"

if SOC_SIFIVE || SOC_STARFIVE

config ESWIN_KHANDLE
    bool "eswin kernel khandle functions"
    default y
    help
        eswin realize this khandle, and mainly use for user process resource
        mangement.

config ESWIN_DSP_SUBSYS
    tristate "Eswin dsp subsys"
    default y
    help
      This is hardware-specific DSP subsys kernel driver for the eswin
      hardware. It should be enabled to support dsp on eswin
      platform.

      If unsure, say N.

config EIC7X_D2D
    bool "Eswin EIC7X D2D interrupt status"
    depends on ARCH_ESWIN_EIC7702_SOC
    help
        This is interrputs status of D2D which includes error interrupts.

config EIC770X_OTP
    tristate "Eswin EIC770X OTP driver"
	default y
    help
       This driver provides access to the One-Time Programmable (OTP)
       memory on the Eswin EIC770X platform via debugfs.
       If unsure, say N.
endif
```

## drivers/soc/eswin/ai_driver/Kconfig
```kconfig
config ESWIN_DSP
    tristate "Eswin DSP"
    default n

config DSP_PERF
    bool "DSP PERF"
    default n
    depends on ESWIN_DSP

config ESWIN_NPU
    tristate "Eswin NPU"
    default n
    depends on ESWIN_DSP
    select ESWIN_DEV_DMA_BUF
    select ESWIN_IOMMU_RSV
    select ESWIN_RSVMEM_HEAP

config NPU_PERF
    bool "NPU PERF"
    default n
    depends on ESWIN_NPU
```

## drivers/soc/sifive/Kconfig
```kconfig
# SPDX-License-Identifier: GPL-2.0

if SOC_SIFIVE || SOC_STARFIVE

config SIFIVE_CCACHE
	bool "Sifive Composable Cache controller"
	help
	  Support for the composable cache controller on SiFive platforms.

config ARCH_ESWIN_EIC770X_SOC_FAMILY
	bool "ESWIN EIC770X SoC Family"
	depends on SOC_SIFIVE
	select SIFIVE_CCACHE
	select RISCV_NONSTANDARD_CACHE_OPS
	select DMA_DIRECT_REMAP
	select RISCV_DMA_NONCOHERENT
	select ARCH_HAS_DMA_SET_UNCACHED
	select ARCH_HAS_DMA_CLEAR_UNCACHED
	select ESWIN_MC
	select ESWIN_RSV_MEMBLOCK
	select ESWIN_CODACACHE_CONTROLLER

menu "ESWIN EIC770X SoC Family Selection"
	depends on ARCH_ESWIN_EIC770X_SOC_FAMILY

choice
	prompt "ESWIN EIC770X SoC Family Selection"
	help
	  This option select the SoC type of ESWIN EIC770X Family.

config ARCH_ESWIN_EIC7700_SOC
	bool "Enable support for ESWIN EIC7700 SoC"

config ARCH_ESWIN_EIC7702_SOC
	bool "Enable support for ESWIN EIC7702 SoC"

endchoice
endmenu

if ARCH_ESWIN_EIC770X_SOC_FAMILY
config RISCV_DIE0_UNCACHED_OFFSET
	hex "DIE0 system port addr of U84"
	default 0xc000000000
	help
	  Access to DDR memory through U84 system port is uncached.
	  Add this offset when allocating  memory from memory port(0x80000000~),
	  then memremap to virtual address.

config RISCV_DIE0_CACHED_OFFSET
	hex "DIE0 memory port addr of U84"
	default 0x80000000
	help
	  Access to DDR memory through U84 memory port is cached.

config RISCV_DIE0_MEM_MAX_SIZE
	hex "DIE0 memory size, default 32GB"
	default 0x800000000

config RISCV_DIE1_UNCACHED_OFFSET
	hex "DIE1 system port addr of U84"
	default 0xe000000000
	help
	  Access to DIE1 DDR memory through U84 system port is uncached.
	  Add this offset when allocating  memory from memory port(0x2000000000~),
	  then memremap to virtual address.

config RISCV_DIE1_CACHED_OFFSET
	hex "DIE1 memory port addr of U84"
	default 0x2000000000
	help
	  Access to DIE1 DDR memory through U84 memory port is cached.

config RISCV_DIE1_MEM_MAX_SIZE
	hex "DIE1 memory size, default 32GB"
	default 0x800000000

config RISCV_INTERLEAVE_UNCACHED_OFFSET
	hex "system port addr of interleave"
	default 0x10000000000
	help
	  Access to DDR memory through U84 system port with interleave is uncached.
	  Add this offset when allocating  memory from memory port(0x4000000000~),
	  then memremap to virtual address.

config RISCV_INTERLEAVE_CACHED_OFFSET
	hex "memory port addr of interleave"
	default 0x4000000000
	help
	  Access to DDR memory through U84 memory port with interleave is cached.

config RISCV_INTERLEAVE_MEM_MAX_SIZE
	hex "Interleaving memory size, default 64GB"
	default 0x1000000000
endif
endif
```
