## drivers/staging/media/eswin/Kconfig
```kconfig
# SPDX-License-Identifier: GPL-2.0-only

config VIDEO_ESWIN
	bool "Eswin Video IP"
	help
	  Driver for Eswin Video IP Pipelines

source "drivers/staging/media/eswin/vdec/Kconfig"
source "drivers/staging/media/eswin/venc/Kconfig"
source "drivers/staging/media/eswin/hae/Kconfig"
source "drivers/staging/media/eswin/dewarp/Kconfig"
source "drivers/staging/media/eswin/es-media-ext/Kconfig"
```

## drivers/staging/media/eswin/es-media-ext/Kconfig
```kconfig
config VIDEO_ESWIN_MEDIA_EXT_DRIVER
	tristate "Eswin extend Driver"
	depends on VIDEO_ESWIN
	help
	   This is video driver for proc infomation
```

## drivers/staging/media/eswin/hae/Kconfig
```kconfig
config VIDEO_ESWIN_HAE
	tristate "Eswin 2d Graphic Acceleration Unit"
	depends on VIDEO_ESWIN
	help
	  This is 2d graphics accelerator.
```

## sound/soc/sof/eswin/Kconfig
```kconfig
# SPDX-License-Identifier: (GPL-2.0-only OR BSD-3-Clause)

config SND_SOC_SOF_ESWIN_TOPLEVEL
	bool "SOF support for ESWIN win2030 audio DSPs"
	depends on SND_SOC_SOF_OF
	default n
	help
	  This adds support for Sound Open Firmware for ESWIN win2030 platforms.
	  Say Y if you have such a device.
	  If unsure select "N".

if SND_SOC_SOF_ESWIN_TOPLEVEL

config SND_SOC_SOF_ESWIN_COMMON
	bool
	select SND_SOC_SOF_OF_DEV
	select SND_SOC_SOF
	select SND_SOC_SOF_IPC3
	select SND_SOC_SOF_XTENSA
	select SND_SOC_SOF_COMPRESS
	help
	  This option is not user-selectable but automagically handled by
	  'select' statements at a higher level.

config SND_SOC_SOF_ESWIN
	tristate "SOF support for eswin"
	select SND_SOC_SOF_ESWIN_COMMON
	default n
	help
	  This adds support for Sound Open Firmware for ESWIN win2030 platforms.
	  Say Y if you have such a device.
	  If unsure select "N".

endif ## SND_SOC_SOF_ESWIN_TOPLEVEL
```
